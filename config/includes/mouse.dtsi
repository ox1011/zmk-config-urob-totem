#include <zephyr/dt-bindings/input/input-event-codes.h>

#define ZMK_POINTING_DEFAULT_MOVE_VAL 1000  // 600
#define ZMK_POINTING_DEFAULT_SCRL_VAL 20    // 10

#include <dt-bindings/zmk/pointing.h>
#include <input/processors.dtsi>

&mmv {
    acceleration-exponent = <1>;      // 1
    time-to-max-speed-ms = <300>;     // 300
    trigger-period-ms = <8>;          // 16
};

&msc {
    acceleration-exponent = <0>;      // 0
    time-to-max-speed-ms = <100>;     // 300
    trigger-period-ms = <8>;          // 8
};
